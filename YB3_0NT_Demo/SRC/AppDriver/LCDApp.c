/****************************************Copyright (c)****************************************************
**                         			BEIJING	WANJI(WJ)                               
**                                     
**
**--------------File Info---------------------------------------------------------------------------------
** File name:			LCDApp.C
** Last modified Date:  20110418
** Last Version:		1.0
** Descriptions:		LCD应用程序
**
**--------------------------------------------------------------------------------------------------------
** Created by:			ZHANG Ye
** Created date:		20110418
** Version:				1.0
** Descriptions:		
**
**--------------------------------------------------------------------------------------------------------
** Modified by:			
** Modified date:		
** Version:
** Descriptions:
**
*********************************************************************************************************/
#define	__LCDAPP_C 
#include "LCDApp.h"

#define	REG_BKG_OFF			P3_OUTP_CLR		//关闭背景灯寄存器
#define	REG_BKG_ON			P3_OUTP_SET		//点亮背景灯寄存器

static	uint8	m_u8BGStatus;		//背景灯点亮状态
static	uint8	m_u8BGSaveStatus;	//背景灯点亮状态

static	uint8	const	m_au8Pic[] = 
{

/*----  图片文件来自: 【D:\我的文档\My Pictures\wj.bmp】  ----*/
/*----  图片宽度: 240     图片高度: 128  ----*/
/*----  本数据文件建立日期: 202006-7-14;  建立时间: 17:15:57  ----*/
/*----  本数据文件由PICtoCODE【图片数据生成器】V1.0自动生成！  ----*/
0x00, 0x00, 0x00, 0x00, 0x00, 0x00, 0x00, 0x00, 0x00, 0x00, 0x00, 0x00, 0x00, 0x00, 0x00, 0x00, 
0x00, 0x00, 0x00, 0x00, 0x00, 0x00, 0x00, 0x00, 0x00, 0x00, 0x00, 0x00, 0x00, 0x00, 
0x00, 0x00, 0x00, 0x00, 0x00, 0x00, 0x00, 0x00, 0x00, 0x00, 0x00, 0x00, 0x00, 0x00, 0x00, 0x00, 
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0x00, 0x00, 0x00, 0x00, 0x00, 0x00, 0x00, 0x00, 0x00, 0x00, 0x00, 0x00, 0x00, 0x00
};

/*********************************************************************************************************
** Function name:           DrawLineModify
**
** Descriptions:            画线修图像
**
** input parameters:        None
** output parameters:       None
** Returned value:          None
**
** Created by:              ZHANG Ye
** Created Date:            20110511
**--------------------------------------------------------------------------------------------------------
** Modified by:
** Modified date:
**--------------------------------------------------------------------------------------------------------
*********************************************************************************************************/
void DrawLineModify(uint16 *p_pModifyParam)
{
  	 int32 j,a;

 	 j=10;
						
	  for(a=0;a<239;a=a+7)
	  {
	     GUI_Point(a,100,1);
	  }
	 
	  for(a=0;a<10;a++)
	  {
		 GUI_Line(0,75+a*5,8,75+a*5,1);
	  }

	  a=0;
	  while(a<31)
	  { 		
		 GUI_Line(j,100-(*(p_pModifyParam+a)-10000)/40,j+7,100-(*(p_pModifyParam+a+1)-10000)/40,1);

		 if((a %4)==0)GUI_Line(j,73,j,127,1);
	   	 if((a %4)==0)
		 {
			PrintFormatDataXY(j-4,56,"%d",a );
		 }
		 a++;

		 j=j+7 ;
	  }
}

/*********************************************************************************************************
** Function name:           BackGroundON
**
** Descriptions:            点亮背景灯
**
** input parameters:        None
** output parameters:       None
** Returned value:          None
**
** Created by:              ZHANG Ye
** Created Date:            20110418
**--------------------------------------------------------------------------------------------------------
** Modified by:
** Modified date:
**--------------------------------------------------------------------------------------------------------
*********************************************************************************************************/
void BackGroundON(void)
{
	m_u8BGStatus	= 1;
	REG_BKG_ON		= LCM_LEDCON;
}

/*********************************************************************************************************
** Function name:           BackGroundOFF
**
** Descriptions:            关闭背景灯
**
** input parameters:        None
** output parameters:       None
** Returned value:          None
**
** Created by:              ZHANG Ye
** Created Date:            20110418
**--------------------------------------------------------------------------------------------------------
** Modified by:
** Modified date:
**--------------------------------------------------------------------------------------------------------
*********************************************************************************************************/
void BackGroundOFF(void)
{
	m_u8BGStatus	= 0;
	REG_BKG_OFF		= LCM_LEDCON;
}

/*********************************************************************************************************
** Function name:           CheckOutBGStatus
**
** Descriptions:            关闭背景灯
**
** input parameters:        None
** output parameters:       None
** Returned value:          None
**
** Created by:              ZHANG Ye
** Created Date:            20110418
**--------------------------------------------------------------------------------------------------------
** Modified by:
** Modified date:
**--------------------------------------------------------------------------------------------------------
*********************************************************************************************************/
void CheckOutBGStatus(void)
{
	if (m_u8BGStatus || OUTBGON)		//有一个为点亮
		REG_BKG_ON		= LCM_LEDCON;
	else								//都不亮
		REG_BKG_OFF		= LCM_LEDCON;
}

/*********************************************************************************************************
** Function name:           BackGroundReverse
**
** Descriptions:            反转背景灯，打开的关闭，关闭的打开
**
** input parameters:        None
** output parameters:       None
** Returned value:          None
**
** Created by:              ZHANG Ye
** Created Date:            20110418
**--------------------------------------------------------------------------------------------------------
** Modified by:
** Modified date:
**--------------------------------------------------------------------------------------------------------
*********************************************************************************************************/
void BackGroundReverse(void)
{
	m_u8BGStatus	^= 0x01;
	if (m_u8BGStatus == 1)
		REG_BKG_ON		= LCM_LEDCON;
	else
		REG_BKG_OFF		= LCM_LEDCON;
}

/*********************************************************************************************************
** Function name:           BackGroundSave
**
** Descriptions:            记录背光灯状态
**
** input parameters:        None
** output parameters:       None
** Returned value:          None
**
** Created by:              ZHANG Ye
** Created Date:            20110627
**--------------------------------------------------------------------------------------------------------
** Modified by:
** Modified date:
**--------------------------------------------------------------------------------------------------------
*********************************************************************************************************/
void BackGroundSave(void)
{
	m_u8BGSaveStatus	= m_u8BGStatus;
}
/*********************************************************************************************************
** Function name:           BackGroundRecover
**
** Descriptions:            恢复背光灯状态
**
** input parameters:        None
** output parameters:       None
** Returned value:          None
**
** Created by:              ZHANG Ye
** Created Date:            20110627
**--------------------------------------------------------------------------------------------------------
** Modified by:
** Modified date:
**--------------------------------------------------------------------------------------------------------
*********************************************************************************************************/
void BackGroundRecover(void)
{									
	m_u8BGStatus	= m_u8BGSaveStatus;
	if (m_u8BGStatus == 1)
		REG_BKG_ON		= LCM_LEDCON;
	else
		REG_BKG_OFF		= LCM_LEDCON;
}
/*********************************************************************************************************
** Function name:           Enter
**
** Descriptions:            显示屏输入点坐标跳至下一行开始位置
**
** input parameters:        None
** output parameters:       None
** Returned value:          None
**
** Created by:              ZHANG Ye
** Created Date:            20110418
**--------------------------------------------------------------------------------------------------------
** Modified by:
** Modified date:
**--------------------------------------------------------------------------------------------------------
*********************************************************************************************************/
void Enter(void)
{
	g_u8PosX	= 0;
	if (g_u8PosY < 112)
		g_u8PosY	+= 16;
	else
		g_u8PosY	= 0;
}

/*********************************************************************************************************
** Function name:           GotoXY
**
** Descriptions:            显示屏输入点坐标跳至指定位置
**
** input parameters:        p_u8X、p_u8Y：指定位置坐标
** output parameters:       None
** Returned value:          None
**
** Created by:              ZHANG Ye
** Created Date:            20110418
**--------------------------------------------------------------------------------------------------------
** Modified by:
** Modified date:
**--------------------------------------------------------------------------------------------------------
*********************************************************************************************************/
void	GotoXY(uint8 p_u8X, uint8 p_u8Y)
{
	if (p_u8X < 240)		//判断坐标是否超出显示屏范围
		g_u8PosX	= p_u8X;
	else
		g_u8PosX	= 0;

	if (p_u8Y < 128)		//判断坐标是否超出显示屏范围
		g_u8PosY	= p_u8Y;
	else
		g_u8PosY	= 0;
}

/*********************************************************************************************************
** Function name:           PrintChar
**
** Descriptions:            在当前坐标点输出字符
**
** input parameters:        p_cStr：字符指针
** output parameters:       None
** Returned value:          None
**
** Created by:              ZHANG Ye
** Created Date:            20110418
**--------------------------------------------------------------------------------------------------------
** Modified by:
** Modified date:
**--------------------------------------------------------------------------------------------------------
*********************************************************************************************************/
void PrintChar(char * p_cStr)
{
	char l_cParam1,l_cParam2;

    while(*p_cStr != '\0')		//一直显示，直到字符串结束
    {
     	l_cParam1	= *p_cStr++;

		if(l_cParam1 < 0x80)		// 如果是字符
		{
			GUI_PutString8_16A(g_u8PosX, g_u8PosY, l_cParam1);
			if(g_u8PosX < 232)
			{
				g_u8PosX	+= 8;
			}
			else
			{
			  	Enter();			
			}
		}		// 如果是字符
    	else		 				// 如果是汉字
		{									
			l_cParam2 = *p_cStr++;
			if((l_cParam2 == '\0')||(l_cParam2 < 0x80)) 
				return;
		
			GUI_hz( g_u8PosX, g_u8PosY, l_cParam1,l_cParam2) ;


			if(g_u8PosX < 224)
			{
				g_u8PosX	+= 16;
			}
			else
			{
		  		Enter();
			}
       	}		// 如果是汉字
	}				//while(*p_cStr != '\0')
}	

/*********************************************************************************************************
** Function name:           PrintCharXY
**
** Descriptions:            在指定坐标点输出字符
**
** input parameters:        p_cStr：字符指针
**							p_u8X, p_u8Y：指定坐标
** output parameters:       None
** Returned value:          None
**
** Created by:              ZHANG Ye
** Created Date:            20110418
**--------------------------------------------------------------------------------------------------------
** Modified by:
** Modified date:
**--------------------------------------------------------------------------------------------------------
*********************************************************************************************************/			
void PrintCharXY(uint8 p_u8X, uint8 p_u8Y, char * p_cStr)
{
	g_u8PosX	= p_u8X;
	g_u8PosY	= p_u8Y;
	PrintChar(p_cStr);
}

/*********************************************************************************************************
** Function name:           PrintFormatData
**
** Descriptions:            在当前坐标点按照一定格式输出数字
**
** input parameters:        p_cFormat：一定格式
**							p_u32Data：指定坐标
** output parameters:       None
** Returned value:          None
**
** Created by:              ZHANG Ye
** Created Date:            20110418
**--------------------------------------------------------------------------------------------------------
** Modified by:
** Modified date:
**--------------------------------------------------------------------------------------------------------
*********************************************************************************************************/		
void PrintFormatData(char * p_cFormat, uint32 p_u32Data)
{
	char str[32];
	sprintf(str,p_cFormat,p_u32Data);	
	PrintChar(str);	
}

/*********************************************************************************************************
** Function name:           PrintFormatData
**
** Descriptions:            在指定坐标点按照一定格式输出数字
**
** input parameters:        p_u8X, p_u8Y：指定坐标
**							p_cFormat：一定格式
**							p_u32Data：指定坐标
** output parameters:       None
** Returned value:          None
**
** Created by:              ZHANG Ye
** Created Date:            20110418
**--------------------------------------------------------------------------------------------------------
** Modified by:
** Modified date:
**--------------------------------------------------------------------------------------------------------
*********************************************************************************************************/	
void PrintFormatDataXY(uint8 p_u8X, uint8 p_u8Y, char * p_cFormat, uint32 p_u32Data)
{
	char str[32];
	g_u8PosX	= p_u8X;
	g_u8PosY	= p_u8Y;
	sprintf(str,p_cFormat,p_u32Data);	
	PrintChar(str);	
}

/*********************************************************************************************************
** Function name:           LCDDisplay
**
** Descriptions:            在指定坐标点按照一定格式输出数字
**
** input parameters:        p_u8X, p_u8Y：指定坐标
**							p_cFormat：一定格式
**							p_i32Data：指定坐标
** output parameters:       None
** Returned value:          None
**
** Created by:              ZHANG Ye
** Created Date:            20110418
**--------------------------------------------------------------------------------------------------------
** Modified by:
** Modified date:
**--------------------------------------------------------------------------------------------------------
*********************************************************************************************************/	
void LCDDisplay(uint8 p_u8X, uint8 p_u8Y, char * p_cFormat, uint32 p_i32Data)
{
	char str[32];
	g_u8PosX	= p_u8X;
	g_u8PosY	= p_u8Y;
	sprintf(str,p_cFormat,p_i32Data);	
	PrintChar(str);	
}

/*********************************************************************************************************
** Function name:           DrawPic
**
** Descriptions:            显示默认图片
**
** input parameters:        None
** output parameters:       None
** Returned value:          None
**
** Created by:              ZHANG Ye
** Created Date:            20110418
**--------------------------------------------------------------------------------------------------------
** Modified by:
** Modified date:
**--------------------------------------------------------------------------------------------------------
*********************************************************************************************************/
void DrawPic(void)
{
	GUI_LoadPic(0,0, (uint8 *)m_au8Pic, 240,128);
}

/*********************************************************************************************************
** Function name:           LCDInit
**
** Descriptions:            LCD初始化
**
** input parameters:        None
** output parameters:       None
** Returned value:          None
**
** Created by:              ZHANG Ye
** Created Date:            20110418
**--------------------------------------------------------------------------------------------------------
** Modified by:
** Modified date:
**--------------------------------------------------------------------------------------------------------
*********************************************************************************************************/
void LCDInit(void)
{
	g_u8PosX		= 0;
	g_u8PosY		= 0;

	P1_MUX_CLR		|= ( 0x00000001 );		     //EMC_A0 引脚与P1.0复用，引脚选择A0功能
    P3_MUX_CLR		|= LCDRST | LCM_LEDCON	;    //复位GPO_01( 1<<1 )|背光控制GPO_14(1<<14)

	EMCControl			= 0x01;           /*  使能外部EMC                 */
    EMCConfig			= 0x00;			 /*  EMC配置寄存器--大小端——小端   *****/	
    EMCStaticConfig2	= 0x00000181;	 /*  静态存储器配置寄存器   0x81--16位 **** 0x00--8位  */
	
	EMCStaticExtendedWait = 6;
    EMCStaticWaitWen2  = 0x0f;			 /*  静态存储器写使能延时寄存器  */
    EMCStaticWaitOen2  = 0x0f;			 /*  静态存储器输出使能延时寄存器*/
    EMCStaticWaitRd2   = 0x0f;			/*  静态存储器读延时寄存器      */
	EMCStaticWaitPage2 = 0x1f; 
    EMCStaticWaitWr2   = 0x0f;			 /*  静态存储器写延时寄存器      */
    EMCStaticWaitTurn2 = 0x0f;			 /*  静态存储器转换延时寄存器    */
		
	P3_OUTP_CLR = LCDRST;		//复位LCD
	P3_OUTP_SET = LCDRST;		 																  
				 																  
	REG_BKG_ON		= LCM_LEDCON;
	REG_BKG_OFF		= LCM_LEDCON;
	REG_BKG_ON		= LCM_LEDCON;
		 																  
	GUI_Initialize();					//初始化LCM 
    GUI_SetColor(1, 0);					// 设置前景色及背景色
   
   	GUI_ClearSCR();
	BackGroundOFF();
}
